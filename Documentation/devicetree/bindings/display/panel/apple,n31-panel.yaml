## Documentation/devicetree/bindings/display/panel/apple,n31-panel.yaml
```yaml
# SPDX-License-Identifier: (GPL-2.0-only OR BSD-2-Clause)
%YAML 1.2
---
$id: http://devicetree.org/schemas/display/panel/apple,n31-panel.yaml#
$schema: http://devicetree.org/meta-schemas/core.yaml#

title: Apple iPod nano 7th generation display panel

maintainers:
  - Andrew Green <me@andrewgreen.ca>

description: |
  The 240x432 DCS command-mode panel of the Apple iPod nano 7th generation
  (N31), on a MIPI DSI link from the S5L8740 display controller. Two panel
  variants exist and are told apart by the first byte of manufacturer
  register 0xA1; the driver reads it and picks the initialisation sequence.

allOf:
  - $ref: panel-common.yaml#

properties:
  compatible:
    const: apple,n31-panel

  reg:
    maxItems: 1

  reset-gpios:
    maxItems: 1
    description: Panel reset, SoC pad 15, released before the rail comes up.

  enable-gpios:
    maxItems: 1
    description: |
      Panel enable, SoC pad 14, driven high after the initialisation
      sequence and low before the power-off sequence.

  power-supply:
    description: The panel's rail, PMU_LDO_7 on the D1830 PMIC.

required:
  - compatible
  - reg
  - reset-gpios
  - power-supply

additionalProperties: false

examples:
  - |
    #include <dt-bindings/gpio/gpio.h>

    dsi {
        #address-cells = <1>;
        #size-cells = <0>;

        panel@0 {
            compatible = "apple,n31-panel";
            reg = <0>;
            reset-gpios = <&gpio 15 GPIO_ACTIVE_LOW>;
            enable-gpios = <&gpio 14 GPIO_ACTIVE_HIGH>;
            power-supply = <&display_rail>;
        };
    };
```

## Documentation/devicetree/bindings/display/samsung/samsung,s5l8740-lcdif.yaml
```yaml
# SPDX-License-Identifier: (GPL-2.0-only OR BSD-2-Clause)
%YAML 1.2
---
$id: http://devicetree.org/schemas/display/samsung,s5l8740-lcdif.yaml#
$schema: http://devicetree.org/meta-schemas/core.yaml#

title: Samsung S5L8740 display controller

maintainers:
  - Andrew Green <me@andrewgreen.ca>

description: |
  The display path of the S5L8740 (Apple iPod nano 7th generation) is four
  blocks that only make sense together. The LCDIF carries pixels to a DCS
  command-mode panel over a MIPI DSI host. The frame itself is composed
  from DRAM by a layer compositor and pushed through the LCDIF transfer
  gate, which the driver cycles once per frame. An LCDIF reset has to
  cycle two gates in the clock controller, which is why that block is a
  named window here rather than a clock phandle: the clock controller
  binding for this SoC does not expose those gates.

  The DSI host window makes the node a MIPI DSI host; the panel is its
  child, on channel 0, described by its own binding.

properties:
  compatible:
    const: samsung,s5l8740-lcdif

  reg:
    items:
      - description: LCDIF register window
      - description: clock controller window (two gates cycled on reset)
      - description: MIPI DSI host window
      - description: layer compositor window

  reg-names:
    items:
      - const: lcdif
      - const: clkcon
      - const: dsi
      - const: compositor

  "#address-cells":
    const: 1

  "#size-cells":
    const: 0

patternProperties:
  "^panel@0$":
    type: object
    $ref: panel/apple,n31-panel.yaml#
    unevaluatedProperties: false

required:
  - compatible
  - reg
  - reg-names
  - "#address-cells"
  - "#size-cells"

additionalProperties: false

examples:
  - |
    #include <dt-bindings/gpio/gpio.h>

    display@38300000 {
        compatible = "samsung,s5l8740-lcdif";
        reg = <0x38300000 0x10000>, <0x3c500000 0x100>,
              <0x3d800000 0x1000>, <0x38900000 0x2000>;
        reg-names = "lcdif", "clkcon", "dsi", "compositor";
        #address-cells = <1>;
        #size-cells = <0>;

        panel@0 {
            compatible = "apple,n31-panel";
            reg = <0>;
            reset-gpios = <&gpio 15 GPIO_ACTIVE_LOW>;
            enable-gpios = <&gpio 14 GPIO_ACTIVE_HIGH>;
            power-supply = <&display_rail>;
        };
    };
```

## arch/arm/configs/apple_n31_nodrm_defconfig
```kconfig
# N31 nodrm bisect — no LCD drivers, no initramfs, BL-off witness
CONFIG_ARCH_S5L87XX=y
CONFIG_CPU_S5L8740=y
CONFIG_CMDLINE="panic=-1 loglevel=8 nohlt"
CONFIG_CMDLINE_FORCE=y
CONFIG_PRINTK_TIME=y
CONFIG_S5L8720_TIMER=y
CONFIG_VFP=y
CONFIG_TMPFS=y
CONFIG_DEVTMPFS=y
CONFIG_DEVTMPFS_MOUNT=y
CONFIG_CLK_S5L8702=y
CONFIG_ARM_VIC=y
CONFIG_N31_EARLY_BL_OFF=y
# CONFIG_DRM is not set
# CONFIG_FB is not set
# CONFIG_BLK_DEV_INITRD is not set
# CONFIG_SERIAL_SAMSUNG is not set
# CONFIG_POWER_RESET is not set
```

## arch/arm/configs/apple_n3g_defconfig
```kconfig
CONFIG_ARCH_S5L87XX=y
CONFIG_CPU_S5L8702=y
# CONFIG_ARCH_MULTI_V7 is not set
CONFIG_AEABI=y
CONFIG_CMDLINE="console=ttySAC0,57600 earlycon=s5l,mmio32,0x3cc00000"
CONFIG_CMDLINE_FORCE=y
CONFIG_EARLY_PRINTK=y
CONFIG_ARM_APPENDED_DTB=y
CONFIG_S5L8720_TIMER=y

# Image-size trimming
CONFIG_EXPERT=y
CONFIG_CC_OPTIMIZE_FOR_SIZE=y
CONFIG_PRINTK_TIME=y
# CONFIG_VT is not set
# CONFIG_HW_CONSOLE is not set
# CONFIG_LEGACY_PTYS is not set
# CONFIG_SYSFS_SYSCALL is not set
# CONFIG_FHANDLE is not set
# CONFIG_AIO is not set
# CONFIG_IO_URING is not set
# CONFIG_ADVISE_SYSCALLS is not set
# CONFIG_ELF_CORE is not set
# CONFIG_BASE_FULL is not set
# CONFIG_DEBUG_KERNEL is not set

CONFIG_SERIAL_SAMSUNG=y
CONFIG_SERIAL_SAMSUNG_CONSOLE=y
CONFIG_USB_DWC2=y
CONFIG_USB_GADGET=y
CONFIG_USB_SNP_UDC_PLAT=y
CONFIG_USB_ETH=y
CONFIG_USB_ETH_ECM=y
CONFIG_NET=y
CONFIG_UNIX=y
CONFIG_PACKET=y
CONFIG_INET=y
CONFIG_IP_PNP=y
CONFIG_TMPFS=y
CONFIG_TMPFS_POSIX_ACL=y
CONFIG_DEVTMPFS=y
CONFIG_DEVTMPFS_MOUNT=y
CONFIG_BLK_DEV_INITRD=y
CONFIG_INITRAMFS_SOURCE="freemyipod/initramfs-n3g.cpio.gz"
CONFIG_REGMAP=y
CONFIG_REGMAP_MMIO=y
CONFIG_I2C=y
CONFIG_I2C_S5L8702=y
CONFIG_I2C_CHARDEV=y
CONFIG_SPI=y
CONFIG_SPI_S5L8702=y
CONFIG_SPI_SPIDEV=y
CONFIG_MTD=y
CONFIG_MTD_BLOCK=y
CONFIG_MTD_SPI_NOR=y
CONFIG_MTD_RAW_NAND=y
CONFIG_MTD_NAND_S5L8702=y
```

## arch/arm/configs/apple_n46_defconfig
```kconfig
CONFIG_ARCH_S5L87XX=y
CONFIG_CPU_S5L8702=y
CONFIG_CMDLINE="console=ttySAC0,57600 earlycon=s5l,mmio32,0x3cc00000"
CONFIG_EARLY_PRINTK=y
CONFIG_PRINTK_TIME=y
CONFIG_S5L8702_TIMER=y
CONFIG_SERIAL_SAMSUNG=y
CONFIG_SERIAL_SAMSUNG_CONSOLE=y
CONFIG_PHY_S5L8702_USB2=y
CONFIG_USB_DWC2=y
CONFIG_USB_GADGET=y
CONFIG_USB_SNP_UDC_PLAT=y
CONFIG_USB_ETH=y
CONFIG_USB_ETH_ECM=y
CONFIG_NET=y
CONFIG_UNIX=y
CONFIG_PACKET=y
CONFIG_INET=y
CONFIG_IP_PNP=y
CONFIG_TMPFS=y
CONFIG_TMPFS_POSIX_ACL=y
CONFIG_DEVTMPFS=y
CONFIG_DEVTMPFS_MOUNT=y
CONFIG_UNIX98_PTYS=y
CONFIG_DEVPTS_FS=y
CONFIG_DEBUG_FS=y
# Framebuffer + console on the LCD
CONFIG_FB=y
CONFIG_FB_S5L8702=y
CONFIG_FRAMEBUFFER_CONSOLE=y
CONFIG_FONTS=y
CONFIG_FONT_8x8=y
CONFIG_BLK_DEV_INITRD=y
CONFIG_REGMAP=y
CONFIG_REGMAP_MMIO=y
CONFIG_I2C=y
CONFIG_I2C_S5L8702=y
CONFIG_I2C_CHARDEV=y
CONFIG_SPI=y
CONFIG_SPI_S5L8702=y
CONFIG_SPI_SPIDEV=y
CONFIG_MTD=y
CONFIG_MTD_BLOCK=y
CONFIG_MTD_SPI_NOR=y
CONFIG_MTD_RAW_NAND=y
CONFIG_MTD_NAND_S5L8702=y
CONFIG_CRYPTO=y
CONFIG_CRYPTO_DEV_S5L8702_SHA1=y
CONFIG_CRYPTO_USER_API_HASH=y
CONFIG_CLK_S5L8702=y
CONFIG_AEABI=y
# Image-size trimming
CONFIG_EXPERT=y
CONFIG_CC_OPTIMIZE_FOR_SIZE=y
```

## arch/arm/configs/nano2g_defconfig
```kconfig
CONFIG_SYSVIPC=y
CONFIG_FB_PROVIDE_GET_FB_UNMAPPED_AREA=y
# CONFIG_IPV6 is not set
CONFIG_AEABI=y
# CONFIG_LOGO is not set
# CONFIG_DEBUG_USER is not set
CONFIG_PREEMPT=y
# CONFIG_HZ_PERIODIC is not set
CONFIG_SET_MEM_PARAM=y
CONFIG_DRAM_BASE=0x08000000
CONFIG_DRAM_SIZE=0x02000000
CONFIG_TINYDRM_ILI9320=y
CONFIG_CPU_ARM940T=y
# CONFIG_MMU is not set
# CONFIG_ARM_SINGLE_ARMV7M is not set
CONFIG_HIGH_RES_TIMERS=y
CONFIG_CGROUPS=y
CONFIG_BLK_DEV_INITRD=y
# CONFIG_RD_LZMA is not set
# CONFIG_RD_XZ is not set
# CONFIG_RD_LZO is not set
# CONFIG_RD_ZSTD is not set
CONFIG_EMBEDDED=y
# CONFIG_RUST is not set
CONFIG_ARCH_MULTI_V4T=y
# CONFIG_ARCH_MULTI_V6 is not set
# CONFIG_ARCH_MULTI_V7 is not set
CONFIG_ARCH_S5L87XX=y
CONFIG_CPU_S5L8730=y
CONFIG_CMDLINE="earlyprintk console=tty0 root=/dev/ram0 rw rootfstype=ramfs verbose"
# CONFIG_KEXEC is not set
# CONFIG_EFI is not set
CONFIG_CPU_FREQ=y
CONFIG_CPU_FREQ_STAT=y
CONFIG_CPU_FREQ_DEFAULT_GOV_ONDEMAND=y
CONFIG_CPU_FREQ_GOV_POWERSAVE=m
CONFIG_CPU_FREQ_GOV_USERSPACE=m
CONFIG_CPU_FREQ_GOV_CONSERVATIVE=m
CONFIG_CPUFREQ_DT=y
CONFIG_VFP=y
CONFIG_STRICT_KERNEL_RWX=y
CONFIG_STRICT_MODULE_RWX=y
CONFIG_MODULES=y
CONFIG_MODULE_UNLOAD=y
CONFIG_PARTITION_ADVANCED=y
CONFIG_CMDLINE_PARTITION=y
CONFIG_CMA=y
CONFIG_NET=y
CONFIG_PACKET=y
CONFIG_UNIX=y
CONFIG_INET=y
CONFIG_IP_PNP=y
CONFIG_IP_PNP_DHCP=y
CONFIG_IP_PNP_BOOTP=y
CONFIG_IP_PNP_RARP=y
# CONFIG_IPV6_ROUTER_PREF is not set
# CONFIG_IPV6_OPTIMISTIC_DAD is not set
CONFIG_INET6_AH=m
CONFIG_INET6_ESP=m
CONFIG_INET6_IPCOMP=m
CONFIG_IPV6_MIP6=m
CONFIG_IPV6_TUNNEL=m
CONFIG_IPV6_MULTIPLE_TABLES=y
CONFIG_NET_DSA=m
CONFIG_NET_DSA_TAG_NONE=m
CONFIG_NET_DSA_TAG_BRCM=m
CONFIG_NET_DSA_TAG_BRCM_LEGACY=m
CONFIG_NET_DSA_TAG_BRCM_PREPEND=m
CONFIG_QRTR=m
CONFIG_QRTR_SMD=m
CONFIG_CAN=m
CONFIG_BT=m
CONFIG_BT_HCIUART=m
CONFIG_BT_HCIUART_BCM=y
CONFIG_BT_MRVL=m
CONFIG_CFG80211=m
CONFIG_MAC80211=m
CONFIG_RFKILL=m
# CONFIG_RFKILL_INPUT is not set
CONFIG_RFKILL_GPIO=m
CONFIG_NFC=m
CONFIG_NFC_DIGITAL=m
CONFIG_NFC_NCI=m
CONFIG_NFC_NCI_UART=m
CONFIG_NFC_HCI=m
CONFIG_NFC_SHDLC=y
CONFIG_NFC_S3FWRN5_I2C=m
CONFIG_FAILOVER=y
CONFIG_DEVTMPFS=y
CONFIG_DEVTMPFS_MOUNT=y
CONFIG_EFI_CAPSULE_LOADER=m
CONFIG_BLK_DEV_LOOP=y
CONFIG_BLK_DEV_RAM=y
CONFIG_BLK_DEV_RAM_SIZE=65536
CONFIG_AD525X_DPOT=m
CONFIG_AD525X_DPOT_I2C=m
CONFIG_ICS932S401=m
CONFIG_APDS9802ALS=m
CONFIG_ISL29003=m
CONFIG_EEPROM_AT24=m
CONFIG_EEPROM_93CX6=m
CONFIG_SCSI=m
CONFIG_BLK_DEV_SD=y
CONFIG_BLK_DEV_SR=y
CONFIG_NETDEVICES=y
# CONFIG_ETHERNET is not set
CONFIG_PHYLIB=y
# CONFIG_CAN_DEV is not set
# CONFIG_WLAN is not set
CONFIG_INPUT_FF_MEMLESS=m
CONFIG_INPUT_EVDEV=y
CONFIG_KEYBOARD_QT1070=m
CONFIG_KEYBOARD_GPIO=y
CONFIG_KEYBOARD_SAMSUNG=m
CONFIG_MOUSE_PS2_ELANTECH=y
CONFIG_MOUSE_CYAPA=m
CONFIG_MOUSE_ELAN_I2C=m
CONFIG_SERIAL_8250=y
CONFIG_SERIAL_SAMSUNG=y
CONFIG_SERIAL_SAMSUNG_CONSOLE=y
CONFIG_SERIAL_DEV_BUS=y
CONFIG_HW_RANDOM=y
CONFIG_I2C_CHARDEV=y
CONFIG_I2C_MUX=y
CONFIG_I2C_ARB_GPIO_CHALLENGE=m
CONFIG_I2C_MUX_GPIO=y
CONFIG_I2C_MUX_PCA954x=m
CONFIG_I2C_MUX_PINCTRL=y
CONFIG_I2C_DEMUX_PINCTRL=y
CONFIG_I2C_DESIGNWARE_PLATFORM=m
CONFIG_I2C_EMEV2=m
CONFIG_I2C_RK3X=m
CONFIG_I2C_XILINX=m
CONFIG_I2C_SLAVE_EEPROM=y
CONFIG_PTP_1588_CLOCK=m
CONFIG_PINCTRL=y
CONFIG_PINCTRL_AS3722=m
CONFIG_PINCTRL_MICROCHIP_SGPIO=m
CONFIG_PINCTRL_OCELOT=m
CONFIG_PINCTRL_PALMAS=m
CONFIG_PINCTRL_STMFX=m
CONFIG_GPIO_DWAPB=y
CONFIG_GPIO_SYSCON=m
CONFIG_GPIO_XILINX=m
CONFIG_GPIO_PCA953X=m
# CONFIG_GPIO_PCA953X_IRQ is not set
CONFIG_GPIO_PCF857X=m
# CONFIG_GPIO_PALMAS is not set
# CONFIG_GPIO_TPS6586X is not set
# CONFIG_GPIO_TPS65910 is not set
# CONFIG_GPIO_TWL4030 is not set
# CONFIG_MFD_ACT8945A is not set
# CONFIG_MFD_AS3711 is not set
# CONFIG_MFD_AS3722 is not set
# CONFIG_MFD_ATMEL_FLEXCOM is not set
# CONFIG_MFD_ATMEL_HLCDC is not set
# CONFIG_MFD_BCM590XX is not set
# CONFIG_MFD_AXP20X_I2C is not set
# CONFIG_MFD_DA9063 is not set
# CONFIG_MFD_MAX14577 is not set
# CONFIG_MFD_MAX77686 is not set
# CONFIG_MFD_MAX77693 is not set
# CONFIG_MFD_MAX8907 is not set
# CONFIG_MFD_MAX8997 is not set
# CONFIG_MFD_MAX8998 is not set
# CONFIG_MFD_RK808 is not set
# CONFIG_MFD_RN5T618 is not set
# CONFIG_MFD_SEC_CORE is not set
# CONFIG_MFD_STMPE is not set
# CONFIG_MFD_SYSCON is not set
# CONFIG_MFD_PALMAS is not set
# CONFIG_MFD_TPS65090 is not set
# CONFIG_MFD_TPS65217 is not set
# CONFIG_MFD_TPS65218 is not set
# CONFIG_MFD_TPS6586X is not set
# CONFIG_MFD_TPS65910 is not set
# CONFIG_TWL4030_CORE is not set
# CONFIG_MFD_STPMIC1 is not set
CONFIG_REGULATOR=y
CONFIG_REGULATOR_FIXED_VOLTAGE=y
CONFIG_REGULATOR_ACT8945A=m
CONFIG_REGULATOR_AS3711=m
CONFIG_REGULATOR_AS3722=m
CONFIG_REGULATOR_AXP20X=m
CONFIG_REGULATOR_BCM590XX=m
CONFIG_REGULATOR_DA9210=m
CONFIG_REGULATOR_FAN53555=m
CONFIG_REGULATOR_GPIO=m
CONFIG_REGULATOR_LP872X=m
CONFIG_REGULATOR_MAX14577=m
CONFIG_REGULATOR_MAX8907=m
CONFIG_REGULATOR_MAX8952=m
CONFIG_REGULATOR_MAX8997=m
CONFIG_REGULATOR_MAX8998=m
CONFIG_REGULATOR_MAX77686=m
CONFIG_REGULATOR_MAX77693=m
CONFIG_REGULATOR_MAX77802=m
CONFIG_REGULATOR_PALMAS=m
CONFIG_REGULATOR_RK808=m
CONFIG_REGULATOR_RN5T618=m
CONFIG_REGULATOR_S2MPA01=m
CONFIG_REGULATOR_S2MPS11=m
CONFIG_REGULATOR_S5M8767=m
CONFIG_REGULATOR_STPMIC1=m
CONFIG_REGULATOR_TPS51632=m
CONFIG_REGULATOR_TPS62360=m
CONFIG_REGULATOR_TPS65090=m
CONFIG_REGULATOR_TPS65217=m
CONFIG_REGULATOR_TPS65218=m
CONFIG_REGULATOR_TPS6586X=m
CONFIG_REGULATOR_TPS65910=m
CONFIG_REGULATOR_TWL4030=m
CONFIG_MEDIA_CEC_SUPPORT=y
CONFIG_DRM=y
CONFIG_DRM_DISPLAY_CONNECTOR=m
CONFIG_DRM_LVDS_CODEC=m
CONFIG_DRM_NXP_PTN3460=m
CONFIG_DRM_PARADE_PS8622=m
CONFIG_DRM_SII902X=m
CONFIG_DRM_SII9234=m
CONFIG_DRM_SIMPLE_BRIDGE=m
CONFIG_DRM_TOSHIBA_TC358764=m
CONFIG_DRM_TOSHIBA_TC358768=m
CONFIG_DRM_I2C_ADV7511=m
#TODO:
# CONFIG_TINYDRM_S5L8730 is not set
CONFIG_FB=y
CONFIG_FRAMEBUFFER_CONSOLE=y
CONFIG_FRAMEBUFFER_CONSOLE_ROTATION=y
CONFIG_USB_ULPI_BUS=y
CONFIG_USB_DWC2=y
CONFIG_NOP_USB_XCEIV=y
CONFIG_USB_GADGET=y
CONFIG_USB_GADGET_DEBUG=y
CONFIG_USB_GADGET_VERBOSE=y
CONFIG_USB_SNP_UDC_PLAT=y
CONFIG_USB_ETH=y
# CONFIG_USB_ETH_RNDIS is not set
CONFIG_USB_ETH_EEM=y
CONFIG_DMADEVICES=y
CONFIG_AMBA_PL08X=y
# CONFIG_VIRTIO_MENU is not set
# CONFIG_VHOST_MENU is not set
CONFIG_COMMON_CLK_MAX77686=m
CONFIG_COMMON_CLK_RK808=m
CONFIG_COMMON_CLK_S2MPS11=m
CONFIG_HWSPINLOCK=y
CONFIG_CLKSRC_S5L87XX_PWM=y
# CONFIG_IOMMU_SUPPORT is not set
CONFIG_REMOTEPROC=y
CONFIG_RPMSG_VIRTIO=m
CONFIG_PM_DEVFREQ=y
CONFIG_DEVFREQ_GOV_SIMPLE_ONDEMAND=m
CONFIG_EXTCON_MAX14577=m
CONFIG_EXTCON_MAX77693=m
CONFIG_EXTCON_MAX8997=m
CONFIG_EXTCON_USB_GPIO=y
CONFIG_RESET_CONTROLLER=y
CONFIG_NVMEM_RMEM=m
CONFIG_EXT4_FS=m
CONFIG_AUTOFS4_FS=y
# CONFIG_MSDOS_FS is not set
# CONFIG_VFAT_FS is not set
# CONFIG_NTFS_FS is not set
CONFIG_TMPFS=y
CONFIG_TMPFS_POSIX_ACL=y
CONFIG_SQUASHFS=m
# CONFIG_SQUASHFS_LZO is not set
# CONFIG_SQUASHFS_XZ is not set
CONFIG_PSTORE=y
CONFIG_PSTORE_CONSOLE=y
CONFIG_PSTORE_PMSG=y
CONFIG_PSTORE_RAM=y
# CONFIG_NFS_FS is not set
# CONFIG_NFS_V3_ACL is not set
# CONFIG_NFS_V4 is not set
# CONFIG_NFS_SWAP is not set
CONFIG_ROOT_NFS=y
CONFIG_NLS_CODEPAGE_437=y
CONFIG_NLS_ISO8859_1=y
CONFIG_NLS_UTF8=y
CONFIG_SECURITYFS=y
CONFIG_CRYPTO_USER=m
CONFIG_CRYPTO_CRYPTD=m
CONFIG_CRYPTO_SHA1=m
CONFIG_CRYPTO_ANSI_CPRNG=y
CONFIG_CRYPTO_DRBG_MENU=y
CONFIG_CRYPTO_DRBG_HASH=y
CONFIG_CRYPTO_USER_API_HASH=m
CONFIG_CRYPTO_USER_API_SKCIPHER=m
CONFIG_CRYPTO_USER_API_RNG=m
CONFIG_CRYPTO_USER_API_AEAD=m
CONFIG_PACKING=y
CONFIG_CRC4=m
# CONFIG_XZ_DEC_X86 is not set
# CONFIG_XZ_DEC_POWERPC is not set
# CONFIG_XZ_DEC_IA64 is not set
# CONFIG_XZ_DEC_SPARC is not set
CONFIG_DMA_CMA=y
CONFIG_CMA_SIZE_MBYTES=64
CONFIG_DEBUG_INFO_DWARF5=y
CONFIG_MAGIC_SYSRQ=y
CONFIG_DEBUG_FS=y
CONFIG_DEBUG_LL=y
CONFIG_EARLY_PRINTK=y
```

## arch/arm/mach-s5l87xx/Kconfig
```kconfig
# SPDX-License-Identifier: GPL-2.0

config ARCH_S5L87XX
	bool "Samsung/Apple S5L87XX"

if ARCH_S5L87XX

config CPU_S5L8702
	bool "Enable S5L8702 (iPod nano 3rd Generation / N46) CPU support"
	select ARCH_MULTI_V5
	select ARM_VIC
	help
	  Enable support for the Samsung/Apple S5L8702 SoC (ARM926EJ-S),
	  as found in the iPod nano 3rd Generation (N46).

config CPU_S5L8723
	bool "Enable S5L8723 (iPod nano 6th Generation / N20) CPU support"
	select ARCH_MULTI_V6
	select ARM_VIC
	help
	  Enable support for the Samsung/Apple S5L8723 SoC (ARM1176JZF-S),
	  as found in the iPod nano 6th Generation (N20).

config CPU_S5L8740
	bool "Enable S5L8740 (iPod nano 7th Generation / N31) CPU support"
	select ARCH_MULTI_V7
	select ARM_VIC
	help
	  Enable support for the Samsung/Apple S5L8740 SoC (Cortex-A5),
	  as found in the iPod nano 7th generation (N31).

endif
```
