## drivers/misc/wheel/Kconfig
```kconfig
config IPOD_WHEEL
	tristate "Ipod clickwheel driver"
	default n
	depends on ARCH_S5L87XX
	help
	  Select this option to enable the ipod (click-)wheel driver
```

## freemyipod/kernel_fdt.its
```
/dts-v1/;

/ {
    description = "Single Linux kernel with FDT and initramfs";
    #address-cells = <1>;

    images {
        /* Linux kernel */
        kernel {
            description = "Linux kernel";
            data = /incbin/("zImage");
            type = "kernel";
            arch = "arm";
            os = "linux";
            compression = "none";
            load = <0x08000000>;
            entry = <0x08000000>;
            hash {
                algo = "crc32";
            };
        };

        /* Flattened Device Tree */
        fdt {
            description = "Flattened Device Tree blob";
            data = /incbin/("s5l8740-n31.dtb");
            type = "flat_dt";
            arch = "arm";
            compression = "none";
            hash {
                algo = "crc32";
            };
        };

        /* Gzipped initramfs */
        ramdisk {
            description = "Gzipped Initramfs";
            data = /incbin/("initramfs.cpio.gz");
            type = "ramdisk";
            arch = "arm";
            os = "linux";
            hash {
                algo = "crc32";
            };
        };
    };

    configurations {
        default = "conf-1";
        conf-1 {
            description = "Boot Linux kernel with FDT and initramfs";
            kernel = "kernel";
            fdt = "fdt";
            ramdisk = "ramdisk";
        };
    };
};
```

## freemyipod/kernel_fdt_n3g.its
```
/dts-v1/;

/ {
    description = "Linux kernel + FDT for iPod nano 3g (S5L8702)";
    #address-cells = <1>;

    images {
        kernel {
            description = "Linux kernel";
            data = /incbin/("zImage");
            type = "kernel";
            arch = "arm";
            os = "linux";
            compression = "none";
            load = <0x08000000>;
            entry = <0x08000000>;
            hash {
                algo = "crc32";
            };
        };

        fdt {
            description = "Flattened Device Tree blob";
            data = /incbin/("s5l8702-n3g.dtb");
            type = "flat_dt";
            arch = "arm";
            compression = "none";
            hash {
                algo = "crc32";
            };
        };

        ramdisk {
            description = "Gzipped Initramfs";
            data = /incbin/("initramfs.cpio.gz");
            type = "ramdisk";
            arch = "arm";
            os = "linux";
            hash {
                algo = "crc32";
            };
        };
    };

    configurations {
        default = "conf-1";
        conf-1 {
            description = "Boot Linux kernel with FDT and initramfs";
            kernel = "kernel";
            fdt = "fdt";
            ramdisk = "ramdisk";
        };
    };
};
```

## sound/soc/apple/Kconfig
```kconfig
config SND_SOC_APPLE_MCA
	tristate "Apple Silicon MCA driver"
	depends on ARCH_APPLE || COMPILE_TEST
	select SND_DMAENGINE_PCM
	default ARCH_APPLE
	help
	  This option enables an ASoC platform driver for MCA peripherals found
	  on Apple Silicon SoCs.

config SND_SOC_APPLE_NANO7
	tristate "iPod nano 7G audio machine"
	depends on SND_SOC
	select SND_SOC_APPLE_S5L8740_I2S
	select SND_SOC_APPLE_CS42L81_SPI
	help
	  Registers the ASoC card: CS42L81 headphone playback on IIS0 and
	  BCM2078 FM capture on IIS2, as the two PCMs of one card.

config SND_SOC_APPLE_S5L8740_I2S
	tristate "S5L8740 I2S CPU DAIs (IIS0 playback, IIS2 capture)"
	depends on SND_SOC && HAS_IOMEM
	select SND_SOC_GENERIC_DMAENGINE_PCM
	select SND_DMAENGINE_PCM
	help
	  IIS0 @0x3CA00000 playback (PL080 peri 10) and IIS2 @0x3D400000
	  BCM2078 digital PCM capture (peri 13). Both ports are in one
	  driver because they share the SoC audio clock gate.

config SND_SOC_APPLE_CS42L81_SPI
	tristate "CS42L81 / 338S1146 SPI codec (N31)"
	depends on SPI && SND_SOC
	help
	  RetailOS-matched SPI0 framing (0x6C/0x6D), analog bring-up, and
	  ASoC DAI (cs42l81-hifi). Sysfs reg/bringup/audio_on stay.
```
